## u-boot-new3.its
```
/dts-v1/;

/ {
	description = "Configuration to load U-BOOT, RTOS, FDT";
	#address-cells = <1>;
	fit,fdt-list = "of-list";

	images {
		uboot {
			description = "U-Boot";
			data = /incbin/("u-boot-nodtb.bin");
			type = "standalone";
			os = "U-Boot";
			arch = "riscv";
			compression = "none";
			load = <0x00200000>;
			uboot_blob: blob-ext {
				filename = "u-boot-nodtb.bin";
			};
		};

		rtos {
			description = "RTOS";
			data = /incbin/("Image");
			type = "standalone";
			os = "RTOS";
			arch = "riscv";
			compression = "none";
			load = <0x4E800000>;
			/* load = <0x00400000>; */
			rtos_blob: blob-ext {
				filename = "Image";
			};
		};
		
		initramfs {
				description = "RAMFS";
				data = /incbin/("initramfs.cpio.gz");
				type = "standalone";
				arch = "riscv";
				compression = "none";
				load = <0x48200000>;
				ramfs_blob: blob-ext {
						filename = "initramfs.cpio.gz";
				};
		};

		fdt-rt {
			description = "k1-x-linux-os";
			data = /incbin/("k1-x_rt-deb1.dtb");
			type = "flat_dt";
			arch = "riscv";
			compression = "none";
                        load = <0x42200000>;
			fdt_rt_blob: blob-ext {
				filename = "k1-x_rt-deb1.dtb";
			};
		};
		
		fdt-u-boot {
			description = "k1-x-u-boot";
			data = /incbin/("k1-x_u-boot-deb1.dtb");
			type = "flat_dt";
			arch = "riscv";
			compression = "none";
            load = <0x02200000>;
			fdt_uboot_blob: blob-ext {
				filename = "k1-x_u-boot-deb1.dtb";
			};
		};

		fdt {
			description = "k1-x_deb1";
			data = /incbin/("./arch/riscv/dts/k1-x_deb1.dtb");
			type = "flat_dt";
			arch = "riscv";
			compression = "none";
			fdt_blob: blob-ext {
				filename = "k1-x_deb1.dtb";
			};
		};
	};

	configurations {
		default = "conf";
		conf {
			description = "U-boot FIT image for k1x";
			loadables = "uboot", "rtos", "initramfs", "fdt-rt", "fdt-u-boot";
			fdt = "fdt";
		};
	};
};
```
